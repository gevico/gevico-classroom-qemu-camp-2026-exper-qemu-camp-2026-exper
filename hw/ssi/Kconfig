## hw/ssi/Kconfig
```kconfig
config PL022
    bool
    select SSI

config SIFIVE_SPI
    bool
    select SSI

config SSI
    bool

config SPI_GPIO
    bool
    depends on HAVE_RUST
    select SSI
    select X_I2C_RUST

config XILINX_SPI
    bool
    select SSI

config XILINX_SPIPS
    bool
    select SSI

config STM32F2XX_SPI
    bool
    select SSI

config BCM2835_SPI
    bool
    select SSI

config PNV_SPI
    bool
    select SSI

config ALLWINNER_A10_SPI
    bool
    select SSI
```

## rust/hw/Kconfig
```kconfig
# devices Kconfig
source char/Kconfig
source i2c/Kconfig
source ssi/Kconfig
source timer/Kconfig
```
